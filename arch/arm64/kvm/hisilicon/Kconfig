## arch/arm64/kvm/hisilicon/Kconfig
```kconfig
# SPDX-License-Identifier: GPL-2.0-only
config KVM_HISI_VIRT
	bool "HiSilicon SoC specific virtualization features"
	depends on ARCH_HISI
	help
	  Support for HiSilicon SoC specific virtualization features.
	  On non-HiSilicon platforms, say N here.
```

## drivers/bytedance/Kconfig
```kconfig
# SPDX-License-Identifier: GPL-2.0-only

#
# ByteDance drivers configurations
#
menu "ByteDance drivers support"

config BYTEDANCE
	bool "ByteDance private kernel drivers"
	default n
	help
	  If you want some module which belong to ByteDance say Y.

	  Note that the answer to this question does not directly affect the
	  kernel: saying N will just cause the configurator to skip all the
	  questions about ByteDance modules. If you say Y, you will be asked
	  for your specific modules in the following questions.

config BYTEDANCE_CMA_MEMORY_RESERVE_DRIVER
	tristate "CMA memory reserve char device (per NUMA node)"
	depends on BYTEDANCE && HAS_DMA && MMU
	default n
	help
	  Reserve a chunk of DMA-able memory per online NUMA node and expose it
	  via a character device /dev/cmr_char<N>.

	  Userspace can read/write and mmap the memory to validate DMA mapping
	  behaviors.

	  To compile this driver as a module, choose M here: the module will be
	  called cma_memory_reserve.

endmenu
```

## drivers/bytedance/blackholefs/Kconfig
```kconfig
# SPDX-License-Identifier: GPL-2.0-only
# Copyright (c) 2024, ByteDance Ltd. and/or its affiliates. All rights reserved.
#
# Bytedance module configuration
#
config BYTEDANCE_BLACKHOLEFS
	tristate "ByteDance blackholefs driver"
	default n
	help
	  This driver is blackholefs.
```

## drivers/bytedance/hookbind/Kconfig
```kconfig
# SPDX-License-Identifier: GPL-2.0-only
# Copyright (c) 2024, ByteDance Ltd. and/or its affiliates. All rights reserved.
#
# Bytedance module configuration
#
config BYTEDANCE_HOOKBIND
	tristate "ByteDance hookbind driver"
	default n
	help
	  This driver is used to hook bind syscall.  Details can refer to
	  https://bytedance.feishu.cn/wiki/wikcnso8i1DX1YirVuJcbGbmCYZ
```

## drivers/cpuinspect/Kconfig
```kconfig
# SPDX-License-Identifier: GPL-2.0-only
menu "CPU Inspect"

config CPU_INSPECT
	tristate "CPU inspect support"
	depends on SYSFS && 64BIT
	default n
	help
	  CPU-inspect is designed to provide a framework for early detection
	  of SDC by proactively executing CPU inspection test cases. It
	  includes modular inspector that can be swapped during runtime.

if CPU_INSPECT

config CPU_INSPECTOR_ATF
    tristate "ATF CPU inspector"
        depends on ARM64
        default n
        help
          This inspector implements the execution of inspection instructions
          in BIOS.

endif
endmenu
```

## drivers/platform/x86/amd/Kconfig
```kconfig
# SPDX-License-Identifier: GPL-2.0-only
#
# AMD x86 Platform Specific Drivers
#

source "drivers/platform/x86/amd/hsmp/Kconfig"
source "drivers/platform/x86/amd/pmf/Kconfig"
source "drivers/platform/x86/amd/pmc/Kconfig"
```

## drivers/soc/hisilicon/Kconfig
```kconfig
# SPDX-License-Identifier: GPL-2.0-only

menu "Hisilicon SoC drivers"
	depends on ARCH_HISI || COMPILE_TEST

config KUNPENG_HCCS
	tristate "HCCS driver on Kunpeng SoC"
	depends on ACPI
	depends on MAILBOX
	depends on ARM64 || COMPILE_TEST
	help
	  The Huawei Cache Coherence System (HCCS) is a multi-chip
	  interconnection bus protocol.
	  The performance of application may be affected if some HCCS
	  ports are not in full lane status, have a large number of CRC
	  errors and so on. This may support for reducing system power
	  consumption if there are HCCS ports supported low power feature
	  on platform.

	  Say M here if you want to include support for querying the
	  health status and port information of HCCS, or reducing system
	  power consumption on Kunpeng SoC.

config HISI_SOC_CACHE
	tristate "HiSilicon Cache driver for Kunpeng SoC"
	depends on ARCH_HISI
	help
	  This driver provides the basic utilities for drivers of
	  different part of Kunpeng SoC cache, including L3 cache and
	  Hydra Home Agent etc.

	  If either HiSilicon L3 cache driver or HiSilicon Hydra Home
	  Agent driver is needed, say yes.

config HISI_SOC_HHA
	tristate "HiSilicon Hydra Home Agent (HHA) device driver"
	depends on ARM64 && ACPI || COMPILE_TEST
	depends on HISI_SOC_CACHE
	help
	  The Hydra Home Agent (HHA) is responsible of cache coherency
	  on SoC. This drivers provides cache maintenance functions of HHA.

	  This driver can be built as a module. If so, the module will be
	  called hisi_soc_hha.

endmenu
```
